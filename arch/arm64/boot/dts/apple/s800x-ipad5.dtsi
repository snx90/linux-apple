// SPDX-License-Identifier: GPL-2.0+ OR MIT
/*
 * Apple iPad 5 common device tree
 *
 * Copyright (c) 2022, Konrad Dybcio <konrad.dybcio@somainline.org>
 */

#include <dt-bindings/input/input.h>

/ {
	//todo
};

&serial0 {
	status = "okay";
};
